# npck3m7k register map
Registers are 8-bit, read-write, no defined reset value unless marked. A register's access mark holds for its fields unless they carry their own. Offsets are from the block's base; lines under a group give offsets from that group; [hi:lo] are bit positions; {n}, {i} and the like mark numbered series; 'fields as' and 'values as' point back to an identical list; <NAME> marks a mode.

## Memory map
0x40000000 SHA1-2 size 0x2000 — SHA1-2 Hash Engine Module
0x40001000 PKA size 0x2000 — Public Key Accelerator Module
0x40002000 AES size 0x2000 — AES Module
0x40003000 SMB1 size 0x2000 — SMBus-Interface 1
0x40004000 SMB2 size 0x2000 — SMBus-Interface 2
0x40005000 SMB3 size 0x2000 — SMBus-Interface 3
0x40006000 SMB4 size 0x2000 — SMBus-Interface 4
0x40007000 SMB5 size 0x2000 — SMBus-Interface 5
0x40008000 SMB6 size 0x2000 — SMBus-Interface 6
0x4000B000 SHI size 0x2000 — Serial Host Interface Module
0x4000B000 OBUF0-7 size 0x2000
0x4000B000 OBUF8-15 size 0x2000
0x4000B000 OBUF16-23 size 0x2000
0x4000B000 OBUF24-31 size 0x2000
0x4000B000 OBUF32-39 size 0x2000
0x4000B000 OBUF40-47 size 0x2000
0x4000B000 OBUF48-55 size 0x2000
0x4000B000 OBUF56-63 size 0x2000
0x4000B000 IBUF0-7 size 0x2000
0x4000B000 IBUF8-15 size 0x2000
0x4000B000 IBUF16-23 size 0x2000
0x4000B000 IBUF24-31 size 0x2000
0x4000B000 IBUF32-39 size 0x2000
0x4000B000 IBUF40-47 size 0x2000
0x4000B000 IBUF48-55 size 0x2000
0x4000B000 IBUF56-63 size 0x2000
0x4000C000 MDC size 0x2000 — Miscellaneous Device Control Module
0x4000C000 MDC size 0x2000 — Micellaneous Device Control Module
0x4000D000 PMC size 0x2000 — POWER MANAGEMENT CONTROLLER
0x4000E000 SIB size 0x2000 — SIB Module
0x40010000 SHM size 0x2000 — SHM Module
0x40011000 GDMA size 0x2000 — GDMA Controller Module
0x40012000 ASC size 0x2000 — Core Register Map for ASIF
0x40020000 FIU size 0x2000 — Flash Interface Unit
0x40021000 FIU1 size 0x2000 — Flash Interface Unit 1 (for eSPI)
0x40080000 PWM_A size 0x2000 — Pluse-Width Modulator
{0x40081000+0x2000*n} GPIO{n} size 0x2000 (n=0..9) — GENERAL-PURPOSE I/O
0x40082000 PWM_B size 0x2000 — Pluse-Width Modulator
0x40084000 PWM_C size 0x2000 — Pluse-Width Modulator
0x40086000 PWM_D size 0x2000 — Pluse-Width Modulator
0x40088000 PWM_E size 0x2000 — Pluse-Width Modulator
0x4008A000 PWM_F size 0x2000 — Pluse-Width Modulator
0x4008C000 PWM_G size 0x2000 — Pluse-Width Modulator
0x4008E000 PWM_H size 0x2000 — Pluse-Width Modulator
0x40090000 PWM_I size 0x2000 — Pluse-Width Modulator
0x40092000 PWM_J size 0x2000 — Pluse-Width Modulator
0x40094000 PWM_K size 0x2000 — Pluse-Width Modulator
0x40095000 GPIOA size 0x2000 — GENERAL-PURPOSE I/O
0x40096000 PWM_L size 0x2000 — Pluse-Width Modulator
0x40097000 GPIOB size 0x2000 — GENERAL-PURPOSE I/O
0x40098000 PWM_M size 0x2000 — Pluse-Width Modulator
0x40099000 GPIOC size 0x2000 — GENERAL-PURPOSE I/O
0x4009B000 GPIOD size 0x2000 — GENERAL-PURPOSE I/O
0x4009D000 GPIOE size 0x2000 — GENERAL-PURPOSE I/O
0x4009F000 GPIOF size 0x2000 — GENERAL-PURPOSE I/O
0x400A1000 MailBox size 0x2000 — MailBox Module
0x400A3000 KBS size 0x2000 — Keyboard Scan Modules
0x400A5000 SYSTEM_GLUE size 0x2000 — System Glue Registers
0x400A7000 GPIOG size 0x2000 — GENERAL-PURPOSE I/O
0x400A9000 GPIOH size 0x2000 — GENERAL-PURPOSE I/O
0x400AB000 GPIO_STBY_0 size 0x2000 — GENERAL-PURPOSE I/O
0x400AD000 GPIO_STBY_1 size 0x2000 — GENERAL-PURPOSE I/O
0x400AF000 BBRM_DATA size 0x2000 — memory data
0x400AF100 BBRM size 0x2000 — Battery-Backed RAM
0x400B0000 ITIM32-1 size 0x2000 — INTERNAL 32-BIT TIMER
0x400B1000 PS2 size 0x2000
0x400B2000 ITIM32-2 size 0x2000 — INTERNAL 32-BIT TIMER
0x400B4000 ITIM32-3 size 0x2000 — INTERNAL 32-BIT TIMER
0x400B5000 HFCG size 0x2000 — High-Frequency Clock Generator
0x400B5100 LFCG size 0x2000 — Low-Frequency Clock Generator
0x400B6000 ITIM32-4 size 0x2000 — INTERNAL 32-BIT TIMER
0x400B7000 MTC size 0x2000 — MONOTONIC COUNTER
0x400B8000 ITIM32-5 size 0x2000 — INTERNAL 32-BIT TIMER
0x400BA000 ITIM32-6 size 0x2000 — INTERNAL 32-BIT TIMER
0x400BB000 MIWU-1 size 0x2000 — MULTI-INPUT WAKE-UP
0x400BB000 MIWU-2 size 0x2000 — MULTI-INPUT WAKE-UP
0x400BB000 MIWU-3 size 0x2000 — MULTI-INPUT WAKE-UP
0x400BB000 MIWU-4 size 0x2000 — MULTI-INPUT WAKE-UP
0x400BB000 MIWU-5 size 0x2000 — MULTI-INPUT WAKE-UP
0x400BB000 MIWU-6 size 0x2000 — MULTI-INPUT WAKE-UP
0x400BB000 MIWU-7 size 0x2000 — MULTI-INPUT WAKE-UP
0x400BB000 MIWU-8 size 0x2000 — MULTI-INPUT WAKE-UP
0x400BC000 ITIM64 size 0x2000 — INTERNAL 64-BIT TIMER
0x400BD000 MIWU-1 size 0x2000 — MULTI-INPUT WAKE-UP
0x400BD000 MIWU-2 size 0x2000 — MULTI-INPUT WAKE-UP
0x400BD000 MIWU-3 size 0x2000 — MULTI-INPUT WAKE-UP
0x400BD000 MIWU-4 size 0x2000 — MULTI-INPUT WAKE-UP
0x400BD000 MIWU-5 size 0x2000 — MULTI-INPUT WAKE-UP
0x400BD000 MIWU-6 size 0x2000 — MULTI-INPUT WAKE-UP
0x400BD000 MIWU-7 size 0x2000 — MULTI-INPUT WAKE-UP
0x400BD000 MIWU-8 size 0x2000 — MULTI-INPUT WAKE-UP
0x400BF000 MIWU-1 size 0x2000 — MULTI-INPUT WAKE-UP
0x400BF000 MIWU-2 size 0x2000 — MULTI-INPUT WAKE-UP
0x400BF000 MIWU-3 size 0x2000 — MULTI-INPUT WAKE-UP
0x400BF000 MIWU-4 size 0x2000 — MULTI-INPUT WAKE-UP
0x400BF000 MIWU-5 size 0x2000 — MULTI-INPUT WAKE-UP
0x400BF000 MIWU-6 size 0x2000 — MULTI-INPUT WAKE-UP
0x400BF000 MIWU-7 size 0x2000 — MULTI-INPUT WAKE-UP
0x400BF000 MIWU-8 size 0x2000 — MULTI-INPUT WAKE-UP
0x400C1000 MSWC size 0x2000 — MSWC Module
0x400C3000 SCFG size 0x2000 — SYSTEM CONFIGURATION
0x400C3000 DBG size 0x2000 — Debug Support
0x400C4000 CR_UART size 0x2000 — Core UART
0x400C7000 KBC size 0x2000 — KBC Module
0x400C9000 PM1 size 0x2000 — PM1 Module
0x400CB000 PM2 size 0x2000 — PM2 Module
0x400CD000 PM3 size 0x2000 — PM3 Module
0x400CF000 PM4 size 0x2000 — PM4 Module
0x400D0000 SPIP2 size 0x2000 — SPI Peripheral Interface Module
0x400D1000 ADC size 0x2000 — ADC Module
0x400D1100 DSADC size 0x2000
0x400D2000 SPIP size 0x2000 — SPI Peripheral Interface Module
0x400D4000 PECI size 0x2000 — PECI Controller
0x400D8000 TWD size 0x2000 — TIMER AND WATCHDOG
0x400D9000 RNG size 0x2000 — Random Number Generator Module
0x400DD000 LCT size 0x2000 — LONG COUNTDOWN TIMER
0x400DD000 RTC size 0x2000
0x400E1000 MFT16-1 size 0x2000 — MULTI-FUNCTION 16-BIT TIMER
0x400E3000 MFT16-2 size 0x2000 — MULTI-FUNCTION 16-BIT TIMER
0x400E5000 MFT16-3 size 0x2000 — MULTI-FUNCTION 16-BIT TIMER
0x400E7000 MFT16-4 size 0x2000 — MULTI-FUNCTION 16-BIT TIMER
0x400E9000 MFT16-5 size 0x2000 — MULTI-FUNCTION 16-BIT TIMER
0x400EB000 OWI size 0x2000 — OWI Module
