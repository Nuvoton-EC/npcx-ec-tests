# npcx4m8f register map
Registers are 8-bit, read-write, no defined reset value unless marked. A register's access mark holds for its fields unless they carry their own. Offsets are from the block's base; lines under a group give offsets from that group; [hi:lo] are bit positions; {n}, {i} and the like mark numbered series; 'fields as' and 'values as' point back to an identical list; <NAME> marks a mode.

## Memory map
0x40009000 SMB1 size 0x2000 — SMBus-Interface 1
0x4000B000 SMB2 size 0x2000 — SMBus-Interface 2
0x4000C000 MDC size 0x2000 — Micellaneous Device Control Module
0x4000D000 PMC size 0x2000 — POWER MANAGEMENT CONTROLLER
0x40010000 SHM size 0x2000 — SHM Module
0x40011000 GDMA0-0 size 0x2000 — General DMA Modulator 1
0x40011000 GDMA0-1 size 0x2000 — General DMA Modulator 2
0x40011100 MDMA1-0 size 0x2000 — Mini DMA Modulator
0x40011100 MDMA1-1 size 0x2000 — Mini DMA Modulator
0x40011200 MDMA2-0 size 0x2000 — Mini DMA Modulator
0x40011200 MDMA2-1 size 0x2000 — Mini DMA Modulator
0x40011300 MDMA3-0 size 0x2000 — Mini DMA Modulator
0x40011300 MDMA3-1 size 0x2000 — Mini DMA Modulator
0x40011400 MDMA4-0 size 0x2000 — Mini DMA Modulator
0x40011400 MDMA4-1 size 0x2000 — Mini DMA Modulator
0x40011500 MDMA5-0 size 0x2000 — Mini DMA Modulator
0x40011500 MDMA5-1 size 0x2000 — Mini DMA Modulator
0x40020000 FIU size 0x2000 — Flash Interface Unit
{0x4007E000+0x2000*n} PWM-{n} size 0x2000 (n=1..8) — Pluse-Width Modulator
{0x40081000+0x2000*n} GPIO{n} size 0x2000 (n=0..9) — GENERAL-PURPOSE I/O
0x40095000 GPIOA size 0x2000 — GENERAL-PURPOSE I/O
0x40097000 GPIOB size 0x2000 — GENERAL-PURPOSE I/O
0x40099000 GPIOC size 0x2000 — GENERAL-PURPOSE I/O
0x4009B000 GPIOD size 0x2000 — GENERAL-PURPOSE I/O
0x4009D000 GPIOE size 0x2000 — GENERAL-PURPOSE I/O
0x400A3000 KBS size 0x2000 — Keyboard Scan Module
0x400A5000 SYSTEM_GLUE size 0x2000 — System Glue Registers
0x400B0000 ITIM16-1 size 0x2000 — INTERNAL 16-BIT TIMER
0x400B2000 ITIM16-2 size 0x2000 — INTERNAL 16-BIT TIMER
0x400B4000 ITIM16-3 size 0x2000 — INTERNAL 16-BIT TIMER
0x400B5000 HFCG size 0x2000 — High-Frequency Clock Generator
0x400B5100 LFCG size 0x2000 — Low-Frequency Clock Generator
0x400B6000 ITIM16-4 size 0x2000 — INTERNAL 16-BIT TIMER
0x400B7000 MTC size 0x2000 — MONOTONIC COUNTER
0x400B8000 ITIM16-5 size 0x2000 — INTERNAL 16-BIT TIMER
0x400BA000 ITIM16-6 size 0x2000 — INTERNAL 16-BIT TIMER
0x400BB000 MIWU-1 size 0x2000 — MULTI-INPUT WAKE-UP
0x400BB000 MIWU-2 size 0x2000 — MULTI-INPUT WAKE-UP
0x400BB000 MIWU-3 size 0x2000 — MULTI-INPUT WAKE-UP
0x400BB000 MIWU-4 size 0x2000 — MULTI-INPUT WAKE-UP
0x400BB000 MIWU-5 size 0x2000 — MULTI-INPUT WAKE-UP
0x400BB000 MIWU-6 size 0x2000 — MULTI-INPUT WAKE-UP
0x400BB000 MIWU-7 size 0x2000 — MULTI-INPUT WAKE-UP
0x400BB000 MIWU-8 size 0x2000 — MULTI-INPUT WAKE-UP
0x400BD000 MIWU-1 size 0x2000 — MULTI-INPUT WAKE-UP
0x400BD000 MIWU-2 size 0x2000 — MULTI-INPUT WAKE-UP
0x400BD000 MIWU-3 size 0x2000 — MULTI-INPUT WAKE-UP
0x400BD000 MIWU-4 size 0x2000 — MULTI-INPUT WAKE-UP
0x400BD000 MIWU-5 size 0x2000 — MULTI-INPUT WAKE-UP
0x400BD000 MIWU-6 size 0x2000 — MULTI-INPUT WAKE-UP
0x400BD000 MIWU-7 size 0x2000 — MULTI-INPUT WAKE-UP
0x400BD000 MIWU-8 size 0x2000 — MULTI-INPUT WAKE-UP
0x400BF000 MIWU-1 size 0x2000 — MULTI-INPUT WAKE-UP
0x400BF000 MIWU-2 size 0x2000 — MULTI-INPUT WAKE-UP
0x400BF000 MIWU-3 size 0x2000 — MULTI-INPUT WAKE-UP
0x400BF000 MIWU-4 size 0x2000 — MULTI-INPUT WAKE-UP
0x400BF000 MIWU-5 size 0x2000 — MULTI-INPUT WAKE-UP
0x400BF000 MIWU-6 size 0x2000 — MULTI-INPUT WAKE-UP
0x400BF000 MIWU-7 size 0x2000 — MULTI-INPUT WAKE-UP
0x400BF000 MIWU-8 size 0x2000 — MULTI-INPUT WAKE-UP
0x400C0000 SMB3 size 0x2000 — SMBus-Interface 3
0x400C2000 SMB4 size 0x2000 — SMBus-Interface 4
0x400C3000 SCFG size 0x2000 — SYSTEM CONFIGURATION
0x400C3000 DBG size 0x2000 — Debug Support
0x400C7000 KBC size 0x2000 — KBC Module
0x400C9000 PM1 size 0x2000 — PM1 Module
0x400CB000 PM2 size 0x2000 — PM2 Module
0x400CD000 PM3 size 0x2000 — PM3 Module
0x400CF000 PM4 size 0x2000 — PM4 Module
0x400D1000 ADC size 0x2000 — ADC Module
0x400D4000 PECI size 0x2000 — PECI Controller
0x400D7000 LCT size 0x2000 — LONG COUNTDOWN TIMER
0x400D8000 TWD size 0x2000 — TIMER AND WATCHDOG
0x400E0000 CR_UART0 size 0x2000 — Core UART
0x400E1000 MFT16-1 size 0x2000 — MULTI-FUNCTION 16-BIT TIMER
0x400E2000 CR_UART1 size 0x2000 — Core UART
0x400E3000 MFT16-2 size 0x2000 — MULTI-FUNCTION 16-BIT TIMER
0x400E4000 CR_UART2 size 0x2000 — Core UART
0x400E5000 MFT16-3 size 0x2000 — MULTI-FUNCTION 16-BIT TIMER
0x400E6000 CR_UART3 size 0x2000 — Core UART
