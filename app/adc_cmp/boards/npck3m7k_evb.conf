## app/adc_cmp/boards/npck3m7k_evb.conf
```kconfig
# Add your own Kconfig option for npck3m7k_evb here
CONFIG_SENSOR=y
CONFIG_ADC_CMP_NPCX=y
```

## app/adc_cmp/boards/npcx4m8f_evb.conf
```kconfig
# Add your own Kconfig option for npcx4m8f_evb here
CONFIG_SENSOR=y
CONFIG_SOC_SERIES_NPCX4=y
```

## app/adc_cmp/sample.yaml
```yaml
sample:
  description: ADC sample, the simplest Zephyr application
  name: ADC
common:
    tags: introduction
    integration_platforms:
      - npcx4m8f_evb
    harness: console
    harness_config:
      type: multi_line

tests:
  sample.board.npcx_evb:
    tags: adc_cmp
    filter: CONFIG_SENSOR and
            CONFIG_ADC_ASYNC
    harness: console
```

## app/gpio/sample.yaml
```yaml
sample:
  description: GPIO sample, the simplest Zephyr application
  name: GPIO
common:
    tags: introduction
    integration_platforms:
      - npck3m7k_evb
    harness: console
    harness_config:
      type: multi_line
      regex:
        - "Hello World! (.*)"
```
