## sample.yaml
```
sample:
  description: SHA test SHA256/384/512 suite sample, the simplest Zephyr
    application
  name: sha
common:
    tags: drivers sha
    integration_platforms:
      - npcx4m8f_evb
    harness: console
    harness_config:
      type: multi_line
      regex:
        - "SHA alg: CRYPTO_HASH_ALGO_SHA256, index: (.*)"
        - "SHA alg: CRYPTO_HASH_ALGO_SHA384, index: (.*)"
        - "SHA alg: CRYPTO_HASH_ALGO_SHA512, index: (.*)"
tests:
  sample.board.npcx_evb:
    tags: crypto
    filter: CONFIG_CRYPTO
    harness: console
```

## prj.conf
```kconfig
CONFIG_SERIAL=y
CONFIG_NATIVE_UART_0_ON_STDINOUT=y
CONFIG_PRINTK=y
CONFIG_UART_INTERRUPT_DRIVEN=y
CONFIG_SHELL=y
CONFIG_SHELL_PROMPT_UART="ec:~$ "
CONFIG_LOG=y
```

## boards/npcx4m8f_evb.conf
```kconfig
CONFIG_SERIAL=y
CONFIG_NATIVE_UART_0_ON_STDINOUT=y
CONFIG_PRINTK=y
CONFIG_UART_INTERRUPT_DRIVEN=y
CONFIG_SHELL=y
CONFIG_SHELL_PROMPT_UART="ec:~$ "
CONFIG_LOG=y

CONFIG_MBEDTLS=y
CONFIG_MBEDTLS_BUILTIN=y
CONFIG_MBEDTLS_TEST=y

CONFIG_MBEDTLS_CIPHER_CCM_ENABLED=y
CONFIG_MBEDTLS_CIPHER_GCM_ENABLED=y
CONFIG_MBEDTLS_HEAP_SIZE=512

CONFIG_CRYPTO=y
CONFIG_CRYPTO_MBEDTLS_SHIM=y
CONFIG_CRYPTO_LOG_LEVEL_DBG=y
```

## boards/npcx9m6f_evb.conf
```kconfig
# Add your own Kconfig option for npcx9m6f_evb here
CONFIG_SERIAL=y
CONFIG_NATIVE_UART_0_ON_STDINOUT=y
CONFIG_PRINTK=y
CONFIG_UART_INTERRUPT_DRIVEN=y
CONFIG_SHELL=y
CONFIG_SHELL_PROMPT_UART="ec:~$ "
CONFIG_LOG=y

CONFIG_MBEDTLS=y
CONFIG_MBEDTLS_BUILTIN=y
CONFIG_MBEDTLS_TEST=y

CONFIG_MBEDTLS_CIPHER_CCM_ENABLED=y
CONFIG_MBEDTLS_CIPHER_GCM_ENABLED=y
CONFIG_MBEDTLS_HEAP_SIZE=512

CONFIG_CRYPTO=y
CONFIG_CRYPTO_MBEDTLS_SHIM=y
CONFIG_CRYPTO_LOG_LEVEL_DBG=y
```

## boards/npcx4m8f_evb.overlay
```dts
/*
 * Copyright (c) 2023 Nuvoton Technology Corporation.
 *
 * SPDX-License-Identifier: Apache-2.0
 */

/ {
	chosen {
		zephyr,shell-uart = &uart1;
	};
};

&sha0 {
	status = "okay";
};
```

## src/main.c
```c
/*
 * Copyright (c) 2023 Nuvoton Technology Corporation.
 *
 * SPDX-License-Identifier: Apache-2.0
 */

#include <stdlib.h>
#include <stdio.h>
#include <zephyr/device.h>
#include <zephyr/kernel.h>
#include <zephyr/shell/shell.h>
#include <zephyr/shell/shell_uart.h>
#include <zephyr/crypto/crypto.h>
#include <zephyr/logging/log.h>
#include "sha_data.h"

LOG_MODULE_REGISTER(main);

#define STACK_SIZE                         1024
#define THREAD_PRIORITY                    1
#define LOG_LEVEL LOG_LEVEL_INF
#define CRYPTO_DEV_NODE DT_NODELABEL(sha0)

K_THREAD_STACK_DEFINE(temp_stack, STACK_SIZE);

static struct k_thread sha_id;

const struct device *const sha_dev = DEVICE_DT_GET(CRYPTO_DEV_NODE);

enum hash_algo g_sha = CRYPTO_HASH_ALGO_SHA256;

const char *getSHA_Alg(enum hash_algo alg)
{
	switch (alg) {
	case CRYPTO_HASH_ALGO_SHA256:
		return "CRYPTO_HASH_ALGO_SHA256";
	case CRYPTO_HASH_ALGO_SHA384:
		return "CRYPTO_HASH_ALGO_SHA384";
	case CRYPTO_HASH_ALGO_SHA512:
		return "CRYPTO_HASH_ALGO_SHA512";
	default:
		break;
	}

	return "";
}

static int hash_test(const struct shell *shell, uint8_t index,
		      enum hash_algo sha, struct hash_ctx *ctx)
{
	const struct hash_tp *tp = &hash_test_tbl[(sha - CRYPTO_HASH_ALGO_SHA256)];

	uint8_t ret;
	uint8_t out_buf[64] = {0};
	uint32_t *msg_size = tp->msg_sz;
	uint8_t *dig_ptr = tp->digest;
	uint32_t dig_index = index * tp->digest_sz;
	uint32_t cnt;

	struct hash_pkt pkt = {
		.in_buf = tp->msg[index],
		.in_len = msg_size[index],
		.out_buf = out_buf,
	};

	shell_info(shell, "SHA alg: %s, index: %x", getSHA_Alg(sha), index);

	ret = hash_compute(ctx, &pkt);
	if (ret != 0) {
		shell_error(shell, "Failed to compute hash for test");
		return ret;
	}
	ret = memcmp(pkt.out_buf, &dig_ptr[dig_index], tp->digest_sz);
	if (ret != 0) {
		shell_error(shell, "Not match of result for HASH test");
		for (cnt = 0; cnt < tp->digest_sz; cnt++) {
			if (pkt.out_buf[cnt] != dig_ptr[dig_index + cnt]) {
				shell_info(shell, "out[%x]=%x, dig[%x]=%x", cnt, pkt.out_buf[cnt],
					   cnt, dig_ptr[dig_index + cnt]);
			}
		}
		return ret;
	}

	return 0;
}

static void sha_thread_entry(void *dummy1, void *dummy2, void *dummy3)
{
	if (!device_is_ready(sha_dev)) {
		LOG_INF("%s is not ready\n", sha_dev->name);
		return;
	}

	LOG_INF("sha device %s is ready", sha_dev->name);
}

static int sha_alg_mode(const struct shell *shell, size_t argc, char **argv)
{
	char *eptr;
	uint32_t val = strtoul(argv[1], &eptr, 0);

	if ((val < 2) || (val > 4)) {
		shell_error(shell, "Invalid argument 2 - 4 (%s)", argv[1]);
		return -EINVAL;
	}

	g_sha = val;

	shell_info(shell, "Using SHA Alg %s", getSHA_Alg(g_sha));

	return 0;
}

static int sha_test(const struct shell *shell, size_t argc, char **argv)
{
	int ret, cnt;
	char *eptr;
	struct hash_ctx ctx;
	uint32_t val = strtoul(argv[1], &eptr, 0);

	if ((val < 0) || (val > 7)) {
		shell_error(shell, "Invalid argument 0 - 7 (%s)", argv[1]);
		return -EINVAL;
	}

	shell_info(shell, "Start SHA test...");

	ctx.flags = CAP_SYNC_OPS | CAP_SEPARATE_IO_BUFS;

	ret = hash_begin_session(sha_dev, &ctx, g_sha);
	if (ret != 0) {
		shell_error(shell, "Failed to init session");
		return -EINVAL;
	}

	for (cnt = 0; cnt <= val; cnt++) {
		ret = hash_test(shell, cnt, g_sha, &ctx);
		if (ret != 0) {
			shell_error(shell, "[FAIL] hash_test[%d] fail", cnt);
			return -EINVAL;
		}
	}

	hash_free_session(sha_dev, &ctx);

	shell_info(shell, "[PASS] SHA test completion");
	shell_info(shell, "[GO]");

	return 0;
}

/* Main entry */
int main(void)
{
	k_thread_create(&sha_id, temp_stack, STACK_SIZE, sha_thread_entry, NULL, NULL,
			NULL, THREAD_PRIORITY, K_INHERIT_PERMS, K_FOREVER);
	k_thread_name_set(&sha_id, "sha_testing");
	k_thread_start(&sha_id);
	LOG_INF("Start SHA Task");

	return 0;
}

SHELL_STATIC_SUBCMD_SET_CREATE(sub_sha,
	SHELL_CMD_ARG(set_alg, NULL, "sha set_alg", sha_alg_mode, 2, 0),
	SHELL_CMD_ARG(sha_test, NULL, "sha sha_test", sha_test, 2, 0),
	SHELL_SUBCMD_SET_END /* Array terminated. */
);
SHELL_CMD_REGISTER(sha, &sub_sha, "SHA validation commands", NULL);
```
